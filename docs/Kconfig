## docs/Kconfig
```kconfig
menu "Document"

config DOC__TITLE
    string "Title"
    default "Life is as EasY as YOU Take IT."

config DOC__AUTHOR
    string "Author"
    default "Calidus Callidus"

config DOC__DESCRIPTION
    string "Description"
    default "Essays of an easy life taken seriously."

config DOC__KEYWORDS
    string "Keywords"
    default "life, essay"

config DOC__YEAR
    int "Year"
    default 1976

config DOC__PROJECT
    string "Project"
    default "The Default Project"

config DOC__LANGUAGE
    string "Language"
    default "en"

endmenu


menu "Build"

config BUILD__DIRS__SOURCE
    string "Source Directory"
    default "docs"

config BUILD__DIRS__CONFIG
    string "Config Directory"
    default "docs"

config BUILD__DIRS__BUILD
    string "Build Directory"
    default "out/docs"

config BUILD__LIVE__PORTS__HTML
    int "HTML Port"
    default 1976

endmenu


menu "Publish"

config PUBLISH__BASEURL
    string "Base URL"
    default "https://www.some-host/some/path"

endmenu
```
